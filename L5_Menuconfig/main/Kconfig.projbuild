## L5_Menuconfig/main/Kconfig.projbuild
```kconfig
menu "L5_Menuconfig"

    config OUTPUT_TEXT
        string "Output Text"
        default "www.fambach.net!"
        help
            Enter the text, that will be shown in the program.


endmenu
```

## L6_TASKS_HOOKS/main/Kconfig.projbuild
```kconfig
menu "L6_GPIO_INPUT"

			
	config SW0_ENABLE
		bool "SW0 Enable"
        default false
		help 
			Enable Switch 0 
	config SW0_PIN
		int "SW0 pin"
		range 0 39
        default 34
		depends on SW0_ENABLE
		help 
			Switch 0 Gpio pin
	config SW1_ENABLE
		bool "SW1 Enable"
        default false
		help 
			Enable Switch 1 		
	config SW1_PIN
		int "SW1 pin"
		range 0 39
        default 36
		depends on SW1_ENABLE
		help 
			Switch 1 Gpio pin
	config SW2_ENABLE
		bool "SW2 Enable"
        default false
		help 
			Enable Switch 2
	config SW2_PIN
		int "SW2 pin"
		range 0 39
        default 35
		depends on SW2_ENABLE
		help 
			SW2 Gpio pin
	config LONG_PRESS_ENABLED
		bool "Long press enabled"
        default false
		depends on (SW0_ENABLE || SW1_ENABLE || SW2_ENABLE)
		help 
			If this is enabled the system 
			distinguishes between long pressed buttons and short pressed buttons
	config LONG_PRESS_TIME_MS
		int "Long press time ms"
		range 1000 8000
        default 2000
		depends on LONG_PRESS_ENABLED
		help 
			How long should the a button be pressed to be marked as a long pess	
			If it is not long pressed it is a short press
endmenu
```

## L7_GPIO_OUTPUT/main/Kconfig.projbuild
```kconfig
menu "L6_GPIO"

    config LED_BLINK_DELAY_MS
        int "Delay in mSeconds"
        default "500"
        help
            Enter blink intevall, eg 500ms on + 500ms off .... 
			
	config LED_PIN
		int "LED pin"
		range 0 34
        default 5
		help 
			GPIO Pin to which the LED is conneted


endmenu
```
